## boards/arm/sofle_choc/Kconfig.board
```kconfig
#
# Copyright (c) 2024 The ZMK Contributors
# SPDX-License-Identifier: MIT
#

config BOARD_SOFLE_CHOC_LEFT
    bool "sofle_choc left"
    depends on SOC_NRF52840_QIAA

config BOARD_SOFLE_CHOC_RIGHT
    bool "sofle_choc right"
    depends on SOC_NRF52840_QIAA
```
